## Documentation/devicetree/bindings/leds/leds-class-multicolor.txt
```
* Multicolor LED properties

Bindings for multi color LEDs show how to describe current outputs of
either integrated multi-color LED elements (like RGB, RGBW, RGBWA-UV
etc.) or standalone LEDs, to achieve logically grouped multi-color LED
modules. This is achieved by adding multi-led nodes layer to the
monochrome LED bindings.

The nodes and properties defined in this document are unique to the multicolor
LED class.  Common LED nodes and properties are inherited from the common.txt
within this documentation directory.

Required LED Child properties:
	- color : For multicolor LED support this property should be defined as
		  LED_COLOR_ID_MULTI and further definition can be found in
		  include/linux/leds/common.h.

led-controller@30 {
	#address-cells = <1>;
	#size-cells = <0>;
	compatible = "ti,lp5024";
	reg = <0x29>;

	multi-led@1 {
		#address-cells = <1>;
		#size-cells = <0>;
		reg = <1>;
		color = <LED_COLOR_ID_MULTI>;
		function = LED_FUNCTION_STATUS;


		led@3 {
			reg = <3>;
			color = <LED_COLOR_ID_RED>;
		};

		led@4 {
			reg = <4>;
			color = <LED_COLOR_ID_GREEN>;
		};

		led@5 {
			reg = <5>;
			color = <LED_COLOR_ID_BLUE>;
		};
	};

	multi-led@2 {
		#address-cells = <1>;
		#size-cells = <0>;
		color = <LED_COLOR_ID_MULTI>;
		function = LED_FUNCTION_ACTIVITY;
		reg = <2>;
		ti,led-bank = <2 3 5>;

		led@6 {
			reg = <0x6>;
			color = <LED_COLOR_ID_RED>;
			led-sources = <6 9 15>;
		};

		led@7 {
			reg = <0x7>;
			color = <LED_COLOR_ID_GREEN>;
			led-sources = <7 10 16>;
		};

		led@8 {
			reg = <0x8>;
			color = <LED_COLOR_ID_BLUE>;
			led-sources = <8 11 17>;
		};
	};

	multi-led@4 {
		#address-cells = <1>;
		#size-cells = <0>;
		reg = <4>;
		color = <LED_COLOR_ID_MULTI>;
		function = LED_FUNCTION_ACTIVITY;

		led@12 {
			reg = <12>;
			color = <LED_COLOR_ID_RED>;
		};

		led@13 {
			reg = <13>;
			color = <LED_COLOR_ID_GREEN>;
		};

		led@14 {
			reg = <14>;
			color = <LED_COLOR_ID_BLUE>;
		};
	};

};
```

## Documentation/devicetree/bindings/leds/leds-lp50xx.txt
```
* Texas Instruments - LP5009/12/18/24/30/36 RGB LED driver

The LP50XX is multi-channel, I2C RGB LED Drivers that can group RGB LEDs into
a LED group or control them individually.

The difference in these RGB LED drivers is the number of supported RGB modules.

Required parent properties:
	- compatible:
		"ti,lp5009"
		"ti,lp5012"
		"ti,lp5018"
		"ti,lp5024"
		"ti,lp5030"
		"ti,lp5036"
	- reg :  I2C slave address
		lp5009/12 - 0x14, 0x15, 0x16, 0x17
		lp5018/24 - 0x28, 0x29, 0x2a, 0x2b
		lp5030/36 - 0x30, 0x31, 0x32, 0x33
	- #address-cells : 1
	- #size-cells : 0

Optional parent properties:
	- enable-gpios : gpio pin to enable/disable the device.
	- vled-supply : LED supply

Required child properties:
	- #address-cells : 1
	- #size-cells : 0
	- reg : This is the LED module number.
	- color : Must be LED_COLOR_ID_MULTI
	- function : see Documentation/devicetree/bindings/leds/common.txt

Required child properties only is LED modules will be banked:
	- ti,led-bank : This property denotes the LED module numbers that will
			be controlled as a single RGB cluster.  Each LED module
			number will be controlled by a single LED class instance.
			There can only be one instance of the ti,led-bank
			property for each device node.

Required grandchildren properties:
	- reg : A single entry denoting the LED output that controls
		the monochrome LED.
	- color : see Documentation/devicetree/bindings/leds/common.txt
	- led-sources : see Documentation/devicetree/bindings/leds/common.txt

The LED outputs associated with the LED modules are defined in Table 1 of the
corresponding data sheets.

LP5009 - 3 Total RGB cluster LED outputs 0-2
LP5012 - 4 Total RGB cluster LED outputs 0-3
LP5018 - 6 Total RGB cluster LED outputs 0-5
LP5024 - 8 Total RGB cluster LED outputs 0-7
LP5030 - 10 Total RGB cluster LED outputs 0-9
LP5036 - 12 Total RGB cluster LED outputs 0-11

Optional child properties:
	- label : see Documentation/devicetree/bindings/leds/common.txt
	- linux,default-trigger :
	   see Documentation/devicetree/bindings/leds/common.txt

Examples:
led-controller@29 {
	#address-cells = <1>;
	#size-cells = <0>;
	compatible = "ti,lp5024";
	reg = <0x29>;
	enable-gpios = <&gpio1 28 GPIO_ACTIVE_HIGH>;
	vled-supply = <&vmmcsd_fixed>;

	multi-led@1 {
		#address-cells = <1>;
		#size-cells = <0>;
		reg = <1>;
		color = <LED_COLOR_ID_MULTI>;
		function = LED_FUNCTION_STATUS;

		led@3 {
			reg = <3>;
			color = <LED_COLOR_ID_RED>;
		};

		led@4 {
			reg = <4>;
			color = <LED_COLOR_ID_GREEN>;
		};

		led@5 {
			reg = <5>;
			color = <LED_COLOR_ID_BLUE>;
		};
	};

	multi-led@2 {
		#address-cells = <1>;
		#size-cells = <0>;
		reg = <2>;
		color = <LED_COLOR_ID_MULTI>;
		function = LED_FUNCTION_STANDBY;
		ti,led-bank = <2 3 5>;

		led@6 {
			reg = <0x6>;
			color = <LED_COLOR_ID_RED>;
			led-sources = <6 9 15>;
		};

		led@7 {
			reg = <0x7>;
			color = <LED_COLOR_ID_GREEN>;
			led-sources = <7 10 16>;
		};

		led@8 {
			reg = <0x8>;
			color = <LED_COLOR_ID_BLUE>;
			led-sources = <8 11 17>;
		};
	};

	multi-led@4 {
		#address-cells = <1>;
		#size-cells = <0>;
		reg = <4>;
		color = <LED_COLOR_ID_MULTI>;
		function = LED_FUNCTION_ACTIVITY;

		led@12 {
			reg = <12>;
			color = <LED_COLOR_ID_RED>;
		};

		led@13 {
			reg = <13>;
			color = <LED_COLOR_ID_GREEN>;
		};

		led@14 {
			reg = <14>;
			color = <LED_COLOR_ID_BLUE>;
		};
	};
};

For more product information please see the link below:
http://www.ti.com/lit/ds/symlink/lp5012.pdf
http://www.ti.com/lit/ds/symlink/lp5024.pdf
http://www.ti.com/lit/ds/symlink/lp5036.pdf
```

## Documentation/devicetree/bindings/leds/leds-lp55xx.txt
```
Binding for TI/National Semiconductor LP55xx LED Drivers

Required properties:
- #address-cells: 1
- #size-cells: 0
- compatible: one of
	national,lp5521
	national,lp5523
	ti,lp55231
	ti,lp5562
	ti,lp8501

- reg: I2C slave address
- clock-mode: Input clock mode, (0: automode, 1: internal, 2: external)

Each child has own specific current settings
- led-cur: Current setting at each LED channel (mA x10, 0 if LED is not connected)
- max-cur: Maximun current at each LED channel.
- reg: Output channel for the LED.  This is zero based channel identifier and
	the data sheet is a one based channel identifier.
	reg value to output to LED output number
	D1 = reg value is 0
	D2 = reg value is 1
	D3 = reg value is 2
	D4 = reg value is 3
	D5 = reg value is 4
	D6 = reg value is 5
	D7 = reg value is 6
	D8 = reg value is 7
	D9 = reg value is 8

Optional properties:
- enable-gpio: GPIO attached to the chip's enable pin
- label: Used for naming LEDs
- pwr-sel: LP8501 specific property. Power selection for output channels.
         0: D1~9 are connected to VDD
         1: D1~6 with VDD, D7~9 with VOUT
         2: D1~6 with VOUT, D7~9 with VDD
         3: D1~9 are connected to VOUT

Alternatively, each child can have a specific channel name and trigger:
- chan-name (optional): name of channel
- linux,default-trigger (optional): see
  Documentation/devicetree/bindings/leds/common.txt

example 1) LP5521
3 LED channels, external clock used. Channel names are 'lp5521_pri:channel0',
'lp5521_pri:channel1' and 'lp5521_pri:channel2', with a heartbeat trigger
on channel 0.

lp5521@32 {
	#address-cells = <1>;
	#size-cells = <0>;
	compatible = "national,lp5521";
	reg = <0x32>;
	label = "lp5521_pri";
	clock-mode = /bits/ 8 <2>;

	chan@0 {
		reg = <0>;
		led-cur = /bits/ 8 <0x2f>;
		max-cur = /bits/ 8 <0x5f>;
		linux,default-trigger = "heartbeat";
	};

	chan@1 {
		reg = <1>;
		led-cur = /bits/ 8 <0x2f>;
		max-cur = /bits/ 8 <0x5f>;
	};

	chan@2 {
		reg = <2>;
		led-cur = /bits/ 8 <0x2f>;
		max-cur = /bits/ 8 <0x5f>;
	};
};

example 2) LP5523
9 LED channels with specific name. Internal clock used.
The I2C slave address is configurable with ASEL1 and ASEL0 pins.
Available addresses are 32/33/34/35h.

ASEL1    ASEL0    Address
-------------------------
 GND      GND       32h
 GND      VEN       33h
 VEN      GND       34h
 VEN      VEN       35h

lp5523@32 {
	#address-cells = <1>;
	#size-cells = <0>;
	compatible = "national,lp5523";
	reg = <0x32>;
	clock-mode = /bits/ 8 <1>;

	chan@0 {
		reg = <0>;
		chan-name = "d1";
		led-cur = /bits/ 8 <0x14>;
		max-cur = /bits/ 8 <0x20>;
	};

	chan@1 {
		reg = <1>;
		chan-name = "d2";
		led-cur = /bits/ 8 <0x14>;
		max-cur = /bits/ 8 <0x20>;
	};

	chan@2 {
		reg = <2>;
		chan-name = "d3";
		led-cur = /bits/ 8 <0x14>;
		max-cur = /bits/ 8 <0x20>;
	};

	chan@3 {
		reg = <3>;
		chan-name = "d4";
		led-cur = /bits/ 8 <0x14>;
		max-cur = /bits/ 8 <0x20>;
	};

	chan@4 {
		reg = <4>;
		chan-name = "d5";
		led-cur = /bits/ 8 <0x14>;
		max-cur = /bits/ 8 <0x20>;
	};

	chan@5 {
		reg = <5>;
		chan-name = "d6";
		led-cur = /bits/ 8 <0x14>;
		max-cur = /bits/ 8 <0x20>;
	};

	chan@6 {
		reg = <6>;
		chan-name = "d7";
		led-cur = /bits/ 8 <0x14>;
		max-cur = /bits/ 8 <0x20>;
	};

	chan@7 {
		reg = <7>;
		chan-name = "d8";
		led-cur = /bits/ 8 <0x14>;
		max-cur = /bits/ 8 <0x20>;
	};

	chan@8 {
		reg = <8>;
		chan-name = "d9";
		led-cur = /bits/ 8 <0x14>;
		max-cur = /bits/ 8 <0x20>;
	};
};

example 3) LP5562
4 channels are defined.

lp5562@30 {
	#address-cells = <1>;
	#size-cells = <0>;
	compatible = "ti,lp5562";
	reg = <0x30>;
	clock-mode = /bits/8 <2>;

	chan@0 {
		reg = <0>;
		chan-name = "R";
		led-cur = /bits/ 8 <0x20>;
		max-cur = /bits/ 8 <0x60>;
	};

	chan@1 {
		reg = <1>;
		chan-name = "G";
		led-cur = /bits/ 8 <0x20>;
		max-cur = /bits/ 8 <0x60>;
	};

	chan@2 {
		reg = <2>;
		chan-name = "B";
		led-cur = /bits/ 8 <0x20>;
		max-cur = /bits/ 8 <0x60>;
	};

	chan@3 {
		reg = <3>;
		chan-name = "W";
		led-cur = /bits/ 8 <0x20>;
		max-cur = /bits/ 8 <0x60>;
	};
};

example 4) LP8501
9 channels are defined. The 'pwr-sel' is LP8501 specific property.
Others are same as LP5523.

lp8501@32 {
	#address-cells = <1>;
	#size-cells = <0>;
	compatible = "ti,lp8501";
	reg = <0x32>;
	clock-mode = /bits/ 8 <2>;
	pwr-sel = /bits/ 8 <3>;	/* D1~9 connected to VOUT */

	chan@0 {
		reg = <0>;
		chan-name = "d1";
		led-cur = /bits/ 8 <0x14>;
		max-cur = /bits/ 8 <0x20>;
	};

	chan@1 {
		reg = <1>;
		chan-name = "d2";
		led-cur = /bits/ 8 <0x14>;
		max-cur = /bits/ 8 <0x20>;
	};

	chan@2 {
		reg = <2>;
		chan-name = "d3";
		led-cur = /bits/ 8 <0x14>;
		max-cur = /bits/ 8 <0x20>;
	};

	chan@3 {
		reg = <3>;
		chan-name = "d4";
		led-cur = /bits/ 8 <0x14>;
		max-cur = /bits/ 8 <0x20>;
	};

	chan@4 {
		reg = <4>;
		chan-name = "d5";
		led-cur = /bits/ 8 <0x14>;
		max-cur = /bits/ 8 <0x20>;
	};

	chan@5 {
		reg = <5>;
		chan-name = "d6";
		led-cur = /bits/ 8 <0x14>;
		max-cur = /bits/ 8 <0x20>;
	};

	chan@6 {
		reg = <6>;
		chan-name = "d7";
		led-cur = /bits/ 8 <0x14>;
		max-cur = /bits/ 8 <0x20>;
	};

	chan@7 {
		reg = <7>;
		chan-name = "d8";
		led-cur = /bits/ 8 <0x14>;
		max-cur = /bits/ 8 <0x20>;
	};

	chan@8 {
		reg = <8>;
		chan-name = "d9";
		led-cur = /bits/ 8 <0x14>;
		max-cur = /bits/ 8 <0x20>;
	};
};

Multicolor Framework Support
In addition to the nodes and properties defined above for device support the
properties below are needed for multicolor framework support as defined in
Documentation/devicetree/bindings/leds/leds-class-multicolor.txt

Required child properties for multicolor framework
	- color : Must be LED_COLOR_ID_MULTI
	- function : see Documentation/devicetree/bindings/leds/common.txt

Required grandchildren properties
	- reg : This is the LED output of the device
	- color : see Documentation/devicetree/bindings/leds/common.txt

Multicolor LED example:
lp5523: lp5523@32 {
	#address-cells = <1>;
	#size-cells = <0>;
	compatible = "national,lp5523";
	reg = <0x32>;
	clock-mode = /bits/ 8 <0>; /* LP55XX_CLOCK_AUTO */

	multi-led@2 {
		#address-cells = <1>;
		#size-cells = <0>;
		reg = <2>;
		color = <LED_COLOR_ID_MULTI>;
		function = LED_FUNCTION_STANDBY;
		linux,default-trigger = "heartbeat";

		led@0 {
			led-cur = /bits/ 8 <50>;
			max-cur = /bits/ 8 <100>;
			reg = <0x0>;
			color = <LED_COLOR_ID_GREEN>;
		};

		led@1 {
			led-cur = /bits/ 8 <50>;
			max-cur = /bits/ 8 <100>;
			reg = <0x1>;
			color = <LED_COLOR_ID_BLUE>;
		};

		led@6 {
			led-cur = /bits/ 8 <50>;
			max-cur = /bits/ 8 <100>;
			reg = <0x6>;
			color = <LED_COLOR_ID_RED>;
		};
	};
};
```
